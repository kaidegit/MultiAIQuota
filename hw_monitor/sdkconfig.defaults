## hw_monitor/sdkconfig.defaults.esp32
```kconfig
# ESP32 defaults for the reference Xueersi board (ESP32-WROVER-B, 4 MB flash, no PSRAM).
CONFIG_ESP32_REV_MIN_1=y
```

## hw_monitor/sdkconfig.defaults.esp32s3
```kconfig
# ESP32-S3 defaults (original development target with 8 MB PSRAM).
CONFIG_ESP32S3_REV_MIN_1=y
CONFIG_SPIRAM=y
CONFIG_SPIRAM_SPEED_80M=y
CONFIG_SPIRAM_IGNORE_NOTFOUND=y
```
